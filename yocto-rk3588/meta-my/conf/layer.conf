## yocto-rk3588/meta-my/conf/layer.conf
```bitbake
# We have a conf and classes directory, add to BBPATH
BBPATH .= ":${LAYERDIR}"

# We have recipes-* directories, add to BBFILES
BBFILES += "${LAYERDIR}/recipes-*/*/*.bb \
            ${LAYERDIR}/recipes-*/*/*.bbappend"

BBFILE_COLLECTIONS += "medithinq"
BBFILE_PATTERN_medithinq = "^${LAYERDIR}/"
BBFILE_PRIORITY_medithinq = "7"

LAYERDEPENDS_medithinq += "rockchip"

LAYERVERSION_medithinq = "1"

LAYERSERIES_COMPAT_medithinq = "nanbield scarthgap"

#UBOOT_EXTLINUX_KERNEL_ARGS:append = " quiet loglevel=0 vt.global_cursor_default=0 net.ifnames=0"
```

## yocto-rk3588/meta-my/conf/machine/rock-5b-plus.conf
```bitbake
require conf/machine/include/rk3588.inc

KERNEL_DEVICETREE = "rockchip/rk3588-rock-5b-plus.dtb"

UBOOT_MACHINE = "rk3588_defconfig"
```
